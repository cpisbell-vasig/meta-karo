## conf/layer.conf
```bitbake
# We have a conf and classes directory, add to BBPATH
BBPATH .= ":${LAYERDIR}"

# We have a packages directory, add to BBFILES
BBFILES += "${LAYERDIR}/recipes-*/*/*.bb \
            ${LAYERDIR}/recipes-*/*/*.bbappend"

BBFILE_COLLECTIONS += "karo"
BBFILE_PATTERN_karo := "^${LAYERDIR}/"
BBFILE_PRIORITY_karo = "4"

LAYERSERIES_COMPAT_karo = "rocko thud"
LAYERDEPENDS_karo = "core networking-layer meta-python"

FILESYSTEM_PERMS_TABLES = "meta/files/fs-perms.txt"
```
